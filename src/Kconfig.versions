## src/Kconfig.versions
```kconfig
config KERNEL_6_12
    def_bool y
config KERNEL_6_13
    def_bool y
config KERNEL_6_14
    def_bool y
config KERNEL_6_15
    def_bool y
config KERNEL_6_16
    def_bool y
config KERNEL_6_17
    def_bool y
config KERNEL_6_18
    def_bool y
config KERNEL_6_19
    def_bool y
config KERNEL_6_20
    def_bool y
```
